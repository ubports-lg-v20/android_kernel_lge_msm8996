## arch/arm64/configs/lineageos_h910_defconfig
```kconfig
include lineageos_elsa_common
# LG Platform
CONFIG_MACH_MSM8996_ELSA_ATT_US=y

# Broadcom - Wifi
CONFIG_BCMDHD=y
CONFIG_BCMDHD_LEGACY=y
CONFIG_BCMDHD_PCIE=y
CONFIG_BCM4358=y
CONFIG_BCMDHD_COB=y
CONFIG_BCMDHD_USE_SCHED_SCAN=y
CONFIG_BCMDHD_FOLLOW_AP_DTIM_PERIOD=n
CONFIG_WIFI_CONTROL_FUNC=y

#Hybris config
# Minimum Config
CONFIG_SYSVIPC=y
CONFIG_NAMESPACES=y
CONFIG_UTS_NS=y
CONFIG_IPC_NS=y
CONFIG_USER_NS=y
CONFIG_PID_NS=y
CONFIG_NET_NS=y
CONFIG_DEVTMPFS=y
CONFIG_DEVTMPFS_MOUNT=y
CONFIG_DEVPTS_MULTIPLE_INSTANCES=y
CONFIG_FSNOTIFY=y
CONFIG_DNOTIFY=y
CONFIG_INOTIFY_USER=y
CONFIG_FANOTIFY=y
CONFIG_FANOTIFY_ACCESS_PERMISSIONS=y
CONFIG_SWAP=y
# CONFIG_ANDROID_PARANOID_NETWORK is not set
CONFIG_VT=y
CONFIG_VT_CONSOLE=y

CONFIG_DUMMY=n
CONFIG_AUTOFS4_FS=y=y
CONFIG_CGROUPS=y
CONFIG_PROC_FS=y
CONFIG_SYSFS_DEPRECATED=n
```
